/* boards/max78000fthr.overlay */
#include <zephyr/dt-bindings/gpio/adi-max32-gpio.h>

/* Enable SPI0 on the FTHR headers and attach the SX1276 (RFM9x). */
&spi0 {
    status = "okay";

    /* Chip-select on P0_11, active low, use 3.3V (VDDIOH) */
    cs-gpios = <&gpio0 11 (GPIO_ACTIVE_LOW | MAX32_GPIO_VSEL_VDDIOH)>;

    /* SX1276 on CS index 0 */
    lora: sx1276@0 {
        compatible = "semtech,sx1276";
        reg = <0>;
        /* Radio reset line on P0_19 (active low on SX1276) */
        reset-gpios = <&gpio0 19 (GPIO_ACTIVE_LOW | MAX32_GPIO_VSEL_VDDIOH)>;

        /* DIO0/1/2 interrupt lines (active high), use 3.3V domain */
        dio-gpios = <&gpio1 6 (GPIO_ACTIVE_HIGH | MAX32_GPIO_VSEL_VDDIOH)>,
                    <&gpio2 3 (GPIO_ACTIVE_HIGH | MAX32_GPIO_VSEL_VDDIOH)>,
                    <&gpio2 4 (GPIO_ACTIVE_HIGH | MAX32_GPIO_VSEL_VDDIOH)>;

        /* RFM95/96 uses PA_BOOST path */
        power-amplifier-output = "pa-boost";

        /* SX1276 SPI supports up to 10 MHz; 8 MHz is safe */
        spi-max-frequency = <8000000>;

        status = "okay";
        label = "SX1276";
    };
};

/* Make it easy to fetch in code: DEVICE_DT_GET(DT_ALIAS(lora0)) */
/ {
    aliases {
        lora0 = &lora;
    };
};
